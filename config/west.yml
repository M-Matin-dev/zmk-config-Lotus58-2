## dts/bindings/zmk,behavior-display-anim.yaml
```yaml
description: |
  Turns the nice!view animation mode on or off (see nice_view/widgets/anim.c).
  Off shows the normal status panels. The choice is saved to flash.

compatible: "zmk,behavior-display-anim"

include: zero_param.yaml
```

## dts/bindings/zmk,behavior-led-brightness.yaml
```yaml
description: |
  LED brightness up/down in 2% steps, and 1% steps below 2%. The left half
  works out the new brightness and sends the absolute colour to both halves,
  the same way ZMK's own &rgb_ug brightness keys do.
  Use with LED_BRI or LED_BRD from <dt-bindings/led_brightness.h>.

compatible: "zmk,behavior-led-brightness"

include: two_param.yaml
```

## dts/bindings/zmk,behavior-os-mode.yaml
```yaml
description: |
  Remembers a Mac or Windows mode for each connection (every BLE profile, plus USB)
  and turns the Mac layer on or off to match. The choice is saved to flash, so it
  comes back after a reboot and whenever you switch to that profile.
  Use with OS_WIN, OS_MAC or OS_TOG from <dt-bindings/os_mode.h>.

compatible: "zmk,behavior-os-mode"

include: one_param.yaml

properties:
  mac-layer:
    type: int
    required: true
    description: Index of the layer that holds the Mac mods.
```

## dts/bindings/zmk,reactive-led-strip.yaml
```yaml
description: |
  Per-key reactive LEDs. ZMK's RGB underglow sends each frame (every 50 ms) to
  this device instead of the real LED strip. The LED under a key that was just
  pressed on this half is drawn up to twice as bright, fading back to the
  normal underglow colour over fade-ms. The frame is then passed on to the
  real strip. See src/reactive_led.c.

compatible: "zmk,reactive-led-strip"

properties:
  led-strip:
    type: phandle
    required: true
    description: The real LED strip (for example the ws2812 node).

  chain-length:
    type: int
    required: true
    description: Number of LEDs. ZMK's underglow reads this from the chosen node.

  key-leds:
    type: array
    required: true
    description: |
      LED index for each key position, in keymap order (255 = no LED). Each
      half only reacts to its own key presses, so one table serves both halves.

  fade-ms:
    type: int
    default: 400
    description: How long a pressed key's LED takes to fade back to normal.
```

## zephyr/Kconfig
```kconfig
config LOTUS58_BATTERY_LOG
    bool "Log battery voltage, USB power and split link events to flash"
    depends on SETTINGS && USB_CDC_ACM && BT
    help
      Temporary battery test logger (src/battery_log.c). Read the log over the
      extra USB serial port.

config LOTUS58_BATTERY_LOG_INTERVAL_MIN
    int "Minutes between battery voltage samples"
    default 60
    depends on LOTUS58_BATTERY_LOG

config LOTUS58_BATTERY_LOG_LOAD
    bool "Extra load during the test: blue LED on and CPU kept awake"
    depends on LOTUS58_BATTERY_LOG
    help
      Raises the draw by a few mA so the battery empties sooner. Toggle at run
      time with the b key in the log terminal.

config LOTUS58_DISPLAY_ANIM
    bool "Animation over the top of the nice!view status screen"
    default y
    depends on ZMK_DISPLAY && ZMK_DISPLAY_STATUS_SCREEN_CUSTOM
    help
      nice_view/widgets/anim.c. Toggle at run time with &disp_anim (Adjust + D/K).

config LOTUS58_DISPLAY_ANIM_BOOT_DELAY_SEC
    int "Seconds after power-on before the animation can show"
    default 5
    depends on LOTUS58_DISPLAY_ANIM

config LOTUS58_DISPLAY_ANIM_ADJUST_DELAY_SEC
    int "Seconds after Adjust turns off before the animation comes back"
    default 5
    depends on LOTUS58_DISPLAY_ANIM

config LOTUS58_DISPLAY_ANIM_HIDE_LAYER
    int "Layer index that hides the animation (Adjust)"
    default 4
    depends on LOTUS58_DISPLAY_ANIM
```
