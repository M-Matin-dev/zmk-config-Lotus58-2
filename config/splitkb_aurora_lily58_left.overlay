/*
 * Aurora Lily58, left half, nice!view on the 4-pin OLED header.
 *
 * The nice!view's CS wire goes to the DATA hole, which is nice!nano P0.08
 * (pro_micro 0), not the CS pin the stock nice_view_adapter uses.
 *
 * The header pins are also the Aurora's I2C OLED pins, so the OLED and I2C
 * bus are turned off: the nice!view replaces the OLED.
 */

&nice_view_spi {
    cs-gpios = <&pro_micro 0 GPIO_ACTIVE_LOW>;
};

&pro_micro_i2c {
    status = "disabled";
};
